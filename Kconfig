## Kconfig
```kconfig
config ZMK_LAYER_UNDERGLOW
    bool "Layer-reactive RGB underglow"
    depends on ZMK_RGB_UNDERGLOW
```

## dts/bindings/zmk,layer-underglow.yaml
```yaml
description: |
  Sets RGB underglow color and effect based on which keymap layer is active.
  On each layer change, checks layer-entries for an active layer and applies
  the matching state. When no entry matches, applies CONFIG_ZMK_RGB_UNDERGLOW_*_START.

  A state is (effect H S B): effect index selects the animation, H/S/B set
  the color used by that effect. For spectrum and swirl, H/S/B are ignored.

  Example:
    / {
        layer_underglow: layer_underglow {
            compatible = "zmk,layer-underglow";
            layer-entries = <1 0 240 100 50
                             2 1   0 100 50>;
        };
    };

  layer-entries is a flat array of (layer effect H S B) tuples.
  Entries are checked from last to first; the first match wins,
  so list layers in ascending priority order.

compatible: "zmk,layer-underglow"

properties:
  layer-entries:
    type: array
    description: "Flat array of [layer effect H S B] tuples. See https://zmk.dev/docs/config/lighting for effect indices."
```
